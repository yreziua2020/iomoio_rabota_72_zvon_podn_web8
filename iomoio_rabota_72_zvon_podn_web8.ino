///////////////////////////////////////////////////////////////////////////////////////////////////////////////////////////////////////////////////////////////////////////
#define _ip_adr     //без коментарии 36  работа doma=1 если закоментировать то 36 дома doma=0\

const byte doma=1;  //кагого устройства дома если 0 то в sql не будем отправлять данные  1- работа 2- дома
//const byte doma=1;  //кагого устройства дома если 0 то в sql не будем отправлять данные  1- работа 2- дома
//const byte doma=2;  //кагого устройства дома если 0 то в sql не будем отправлять данные  1- работа 2- дома

const byte _debag=1, _debag2=0, _Dping=0, _Dclock=0,  _D18b20=0;  ///выводиться информация в ком порт //////////////////////////////////////////////////////////////////////////////////////
const byte  _Dwifi=0,  _com_tel=0, _com_sql=0 ;  ///выводиться информация в ком порт ///////
#define Nom_MTS //есл определена (не закоментированна то тогда используем номер мтс)
#ifdef Nom_MTS 
const  String nomer_с ="+380660507748" ;
#else 
const  String nomer_с ="+380660507748" ;
#endif
// Идентификатор устройства (если используется несколько)
#ifdef _ip_adr 
const short UserID=1;
#else 
const short UserID=2;

#endif

////////////////////////////////////////////////////////////////////////////////////////////////////////////////////////////////////////////////////////////////////////////
#include <ESP8266WiFi.h>                                                // Библиотека для создания Wi-Fi подключения (клиент или точка доступа)
#include <ESP8266WebServer.h>                                           // Библиотека для управления устройством по HTTP (например из браузера)
//#include <DNSServer.h>
#include <FS.h>                                                         // Библиотека для работы с файловой системой
#include <ESP8266FtpServer.h>                                           // Библиотека для работы с SPIFFS по FTP
#include <OneWire.h>
#include "AsyncPing.h"            // https://github.com/akaJes/AsyncPing
#include <ESP8266HTTPUpdateServer.h>
//#include <WiFiClientSecure.h>

//#include <StreamUtils.h>      //Для лога оибок парсинга

#include <ArduinoJson.h>           // https://github.com/bblanchon/ArduinoJson  6 версия

#include <IRremoteESP8266.h>
#include <IRsend.h>

#include <SoftwareSerial.h>                     // Библиотека програмной реализации обмена по UART-протоколу
SoftwareSerial SIM800(4, 5);                    // // 8 - RX Arduino (TX SIM800L), 9 - TX Arduino (RX SIM800L)    4.5

#define OTAUSER         "admin"    // Логин для входа в OTA
#define OTAPASSWORD     "admin"    // Пароль для входа в ОТА
//#define OTAPATH         "/firmware"// Путь, который будем дописывать после ip адреса в браузере.
//-----------------------------------------------------------------------------------------------------------------------------------------------
//unsigned int raz_podk;   //сколько раз пробуем подключиться до прпезапуска
//unsigned long t_wifi = millis();  //для файфая
unsigned f_pina_energy=1; //флаг для определения наличия електричества
String _response = "";                          // Переменная для хранения ответа модуля
//---------------------------------------------------Поиск дебаг ненужно взводить--------------------------------------------------------------------------------------------
//#include <Ticker.h>
//float tempDs18b20;  //для поиска
//static byte addr[] = {40,147,215,229,5,0,0,4}; ///для поиска времменый   /////////////////////////поискапоискапоискапоискапоискапоискапоиска поиска поиска
//-----------------------------------------------------------------------------------------------------------------------------------------------
uint16_t f_send_sms_time;  //флаг отправки смсм по веменю
uint16_t f_send_sms_temper;  //флаг отправки смсм по температуре
char icon[20];
unsigned  int nom_dat=0;  //номер датчика начинаем не снуля так как структур наверное
const uint8_t K_dat=4; //количество датчиков // считаем  датчики с нулевого а почемуто при большем значении портило пременую случайным мусором  f_pina_energy
struct targTempDs18 {
  float tDs;
  byte addr[8]; 
};
targTempDs18 TempDs18[] ={
 // {0, {40,147,215,229,5,0,0,4}},
#ifdef _ip_adr 
{0, {40,147,215,229,5,0,0,4}},
#else 
 //{0, {40,255,107,97,1,23,5,32}}, //дома припаен особо точный
 {0, {40,201,76,164,145,33,6,35}}, //в капсуле
#endif  

  {1, {40,3,163,185,5,0,0,13}},
  {2, {40,50,191,229,5,0,0,64}},
  {3, {40,206,26,168,1,0,0,77}},    //самый первый одельнhый
  {4, {40,255,181,102,1,23,5,90}}    //на улицу в серверной 18h20
};

//float tDs_pred[K_dat],tDs_pred2[K_dat],tDs_pred3[K_dat],tDs_pred4[K_dat]; //предыдущее значение температуры для того чтобы не песать миносовые значение или плюсовые
float tDs_pred[K_dat]; //предыдущее значение температуры для того чтобы не песать миносовые значение или плюсовые

//const uint16_t kol_zn=30; //количество значений 
//uint16_t tmp_tt;    //временно для температуры
//uint32_t per_zn;    //прердача значений

//float mas_tm[kol_zn];
//uint16_t mas_tm[kol_zn];

//uint32_t mas_vr[kol_zn];
uint16_t kol_t;
OneWire  ds(0); //пин для подключения датчика DS18B20
unsigned long timer = millis(); //для температуры
unsigned long tem_mas = millis(); //для температуры задержка в масиве
unsigned long t_SQL = millis();  //для отправки даных в sql
unsigned long t_wifi = millis();  //для файфая

int raz_podk;   //сколько раз пробуем подключиться до прпезапуска
 //5 -это красный светодиод
 //String XML; // Переменные для XML запроса


/////////////////////////////////////////////////////////////////////////////////////////////////////////////////
const char* DB_host = "dev.ibc-composite.com";  //host_name
const int   Port = 80;
const char* database_pass = "nsq8VHqjzt1u"; //пароль пользователя базы данных
//переменные контроля напряжения аккумулятора
float bat;
int AO;

WiFiClient client;

/////////////////////////////////////////////////////////////////////////////////////////////////////////////////
/////////////////////////////////////////////////////////////////////////////////////////////////////////////////

#ifdef _ip_adr 
//////////////////////////////////////////работа///////////////////////////////////////////////////////////////////////////////////////////////////
//////////////////////////////////////////работа///////////////////////////////////////////////////////////////////////////////////////////////////
IPAddress ip(192, 168, 1, 36);// Задаем статический IP-адрес:
IPAddress gateway(192,168,1,41);
IPAddress primaryDNS(192, 168, 1, 41);   // опционально
const char* ssid = "home";    
const char* password = "30011980";        


const int kol_kom=60;
struct targetDevice {
  int nom;      //прос
  byte f_wek;   ///флаг запуска компа wek
  byte f_ping;   ///флаг будет пинговаться ли
  String web_ip;
  const char* pingH;
  String deviceName;
  byte mac[6]; //The targets MAC address
};
targetDevice devices[] ={

  {1,  0, 1, "001",   "192.168.1.1",     "Ноутбук",      {0x00,0xae,0xc5,0xbb,0xda,0xba}},
  {2,  1, 1, "037",   "192.168.1.37",    "Подгорный",    {0x30,0x85,0xa9,0xaf,0x3b,0x11}},
  {3,  1, 1, "039",   "192.168.1.39",    "Колипаев",     {0xfc,0x34,0x97,0x0e,0x62,0x93}}, 
  {4,  1, 1, "062",   "192.168.1.62",    "Абакумов",     {0x18,0xc0,0x4d,0x63,0xa2,0x58}}, 
  {5,  1, 1, "066",   "192.168.1.66",    "Шевченк",      {0xc8,0x60,0x00,0xc7,0xb0,0xb7}}, 
  {6,  0, 1, "125",   "192.168.1.125",   "MF4500 Ser",   {0x00,0x60,0x00,0xc7,0xb0,0xb7}},
  {7,  0, 1, "156",   "192.168.1.156",   "Плотер",       {0x00,0x21,0x85,0x17,0xf3,0x07}},  
  {8,  0, 1, "163",   "192.168.1.163",   "RDP кострук",  {0xe0,0xcb,0x4e,0xeb,0x46,0xe9}},    
  {9,  0, 1, "166",   "192.168.1.166",   "Sams-print",   {0x30,0x85,0xa9,0xaf,0x3a,0xce}},
  {10, 1, 1, "176",   "192.168.1.176",   "Курилец",      {0xfc,0x34,0x97,0x12,0x8f,0xe5}}, 
  {11, 1, 1, "186",   "192.168.1.186",   "Шатов",        {0xfc,0x34,0x97,0x0e,0x69,0x17}},  
  {12, 1, 1, "198",   "192.168.1.198",   "Бибер",        {0xbc,0xae,0xc5,0xbb,0xdc,0x65}}, 
  {13, 0, 1, "214",   "192.168.1.214",   "IBT-перегов",  {0x60,0xa4,0x4c,0xb4,0x60,0x60}},  
  
  
  {14, 0, 1, "030",   "192.168.1.30",   "УкрГазБанк",  {0xe0,0xcb,0x4e,0xeb,0x47,0x1d}}, 
  {25, 0, 1, "032",   "192.168.1.32",   "Охрана",       {0xbc,0xae,0xc5,0xbb,0xdc,0x12}},  
  {16, 0, 1, "033",   "192.168.1.33",    "Диалог1",     {0x00,0xae,0xc5,0xbb,0xda,0xba}},
  {17, 0, 1, "038",   "192.168.1.38",    "ДукачаваНо",  {0xf4,0x6d,0x04,0xef,0xdd,0xd8}}, 
  {18, 3, 1, "067",   "192.168.1.67",    "Мой ком",     {0x74,0xd0,0x2b,0x2a,0xad,0x8c}}, 
  {19, 0, 1, "069",   "192.168.1.69",    "Ардуин",      {0x90,0x2b,0x34,0x96,0x34,0xa8}}, 
  {20, 0, 1, "083",   "192.168.1.83",    "Касабова",    {0x5c,0xd9,0x98,0xf8,0x25,0x97}}, 
  {15, 0, 1, "103",   "192.168.1.103",   "нету",        {0xc8,0x60,0x00,0xc7,0xb1,0xba}},  
  {21, 3, 1, "194",   "192.168.1.194",   "Краснокуск",  {0x8c,0x89,0xa5,0xc3,0xe6,0xdc}},  
  {22, 1, 1, "197",   "192.168.1.197",   "Миронов",     {0x00,0xae,0xc5,0xbb,0xda,0xba}},
  {23, 1, 1, "201",   "192.168.1.201",   "ДукачоваСт",  {0x8c,0x89,0xa5,0xc3,0xe8,0x22}},
  {24, 0, 1, "225",   "192.168.1.225",   "Фринет",      {0x74,0xd0,0x2b,0x80,0x7f,0xbb}}, 
  {31, 1, 1, "230",   "192.168.1.230",   "Миронов2",    {0xbc,0xae,0xc5,0xbb,0xdc,0x12}},
  
  
  {27, 0, 1, "007",   "192.168.1.7",     "Регистрат",   {0x00,0xae,0xc5,0xbb,0xda,0xba}},     
  {28, 0, 1, "008",   "192.168.1.8",     "Wi-FI_pkb ",  {0x00,0x00,0xc5,0xbb,0xda,0xba}}, 
  {29, 0, 1, "010",   "192.168.1.10",    "Wi-FI_Ohr",   {0x00,0x00,0xc5,0xbb,0xda,0xba}},
  {30, 0, 1, "031",   "192.168.1.31",    "WF-len:88",   {0x00,0xae,0xc5,0xbb,0xda,0xba}},
  {32, 0, 1, "041",   "192.168.1.41",    "Wi-FI_Фри",   {0x00,0xcb,0x4e,0xeb,0x46,0xe9}}, 
  {33, 0, 1, "044",   "192.168.1.44",    "Каме_серве",  {0x00,0xae,0xc5,0xbb,0xda,0xba}},
  {34, 0, 1, "084",   "192.168.1.84",    "Каме-3этаж",  {0x00,0xae,0xc5,0xbb,0xda,0xba}},
  {35, 0, 1, "085",   "192.168.1.85",    "Каме-Корид",  {0x00,0xae,0xc5,0xbb,0xda,0xba}},
  {36, 0, 1, "086",   "192.168.1.86",    "Каме-Вход",   {0x00,0xae,0xc5,0xbb,0xda,0xba}},
  {37, 0, 1, "120",   "192.168.1.120",   "Рег-Улица",   {0x00,0xae,0xc5,0xbb,0xda,0xba}},   
  {38, 0, 1, "182",   "192.168.1.182",   "Wi-FI_Балк",  {0x00,0xae,0xc5,0xbb,0xda,0xba}}, 
  {26, 0, 1, "241",   "192.168.1.241",   "Нез диалог",  {0x00,0xae,0xc5,0xbb,0xda,0xba}},
  {39, 0, 1, "253",   "192.168.1.253",   "Wi-FI_Юрис",  {0x00,0xae,0xc5,0xbb,0xda,0xba}}, 

  {40, 0, 1, "002",   "192.168.1.2",     "Ex-Serv",     {0x00,0xae,0xc5,0xbb,0xda,0xba}},
  {41, 0, 1, "006",   "192.168.1.6",     "Stor-ser",    {0x1c,0x6f,0x65,0xd8,0x91,0x17}},   //1c-6f-65-d8-91-17  0x1c,0x6f,0x65,0xd8,0x91,0x17
  {42, 0, 1, "009",   "192.168.1.9",     "BDC-serv",    {0x00,0xae,0xc5,0xbb,0xda,0xba}},  
  {43, 0, 1, "011",   "192.168.1.11",    "Bz-serv",     {0x00,0xae,0xc5,0xbb,0xda,0xba}},
  {44, 0, 1, "013",   "192.168.1.13",    "Pop_serv",    {0x00,0xae,0xc5,0xbb,0xda,0xba}},
  {45, 0, 1, "016",   "192.168.1.16",    "PDC-serv",    {0x00,0x30,0x48,0x66,0x9f,0x38}},  // 00-30-48-66-9f-38
  {46, 0, 1, "017",   "192.168.1.17",    "Hyp_serv",    {0x00,0x30,0x48,0xc8,0x92,0x30}},   //00-30-48-c8-92-30  0x00,0x30,0x48,0xc8,0x92,0x30
  {47, 2, 1, "018",   "192.168.1.18",    "1c Upp",      {0x00,0x15,0x17,0xa0,0x7f,0x45}},  
  {48, 0, 1, "024",   "192.168.1.24",    "Inet-serv",   {0x00,0x22,0x15,0x3b,0x35,0xca}},   //00-22-15-3b-35-ca    
  {49, 0, 1, "061",   "192.168.1.61",    "Inet_getv",   {0x00,0xae,0xc5,0xbb,0xda,0xba}},
  {50, 0, 1, "137",   "192.168.1.137",   "Докум_Обо",   {0xbc,0xae,0xc5,0xbb,0xda,0xba}},
  {51, 0, 1, "200",   "192.168.1.200",   "Юлия мани",   {0x74,0xd0,0x2b,0x2a,0xad,0x7b}},
  {52, 0, 1, "212",   "192.168.1.212",   "Камера кр",   {0x60,0xa4,0x4c,0x38,0x61,0xaa}}, // 60-a4-4c-38-61-aa
    
  {53, 0, 1, "029",    "192.168.1.29",   "Wifi_9:8080",   {0xbc,0xae,0xc5,0xbb,0xda,0xba}},
  {54, 0, 1, "015",   "192.168.1.15",   "нету",   {0x74,0xd0,0x2b,0x2a,0xad,0x7b}},
  {55, 0, 1, "246",   "192.168.1.246",  "нету",   {0x00,0xae,0xc5,0xbb,0xda,0xba}}, 
  {56, 0, 1, "247",   "192.168.1.247",  "нету",   {0x74,0xd0,0x2b,0x2a,0xad,0x7b}},
  {57, 0, 1, "248",   "192.168.1.248",  "нету",   {0x74,0xd0,0x2b,0x2a,0xad,0x7b}},
  {58, 0, 1, "249",   "192.168.1.249",  "нету",   {0x00,0xae,0xc5,0xbb,0xda,0xba}}, 
  {59, 0, 1, "251",   "192.168.1.251",  "тел мой",   {0x74,0xd0,0x2b,0x2a,0xad,0x7b}},
  {60, 0, 1, "252",   "192.168.1.252",  "Айфон",   {0x00,0xae,0xc5,0xbb,0xda,0xba}}
  
};
#else 
/////////////////////////////////////////////////дома////////////////////////////////////////////////////////////////////////////////////////////
/////////////////////////////////////////////////дома////////////////////////////////////////////////////////////////////////////////////////////
IPAddress ip(192, 168, 1, 36);// Задаем статический IP-адрес:
IPAddress gateway(192,168,1,199);
IPAddress primaryDNS(192, 168, 1, 199);   // опционально
const char* ssid = "home";
const char* password = "30011980";
//const char* ssid = "MDC_44a";
//const char* password = "Mdc1524a";
//const char* password = "30011980";


const int kol_kom=14;
struct targetDevice {
  int nom;      //прос
  //byte f_ping;   ///флаг будет ли пинговаться хост
  byte f_wek;   ///флаг запуска компа wek
  byte f_ping;   ///флаг будет пинговаться ли
  String web_ip;
  const char* pingH;
  String deviceName;
  byte mac[6]; //The targets MAC address
};
targetDevice devices[] ={

  {1,   0, 1, "056",    "192.168.1.56",   "Кухня",       {0xac,0x22,0x0b,0x78,0x0d,0xc9}}, 
  {1,   0, 1, "026",    "192.168.1.26",   "КомпМам",     {0x60,0xa4,0x4c,0x33,0x2b,0x3a}},    
  {2,   0, 1, "072",    "192.168.1.72",   "КомпНовы",    {0xfc,0x34,0x97,0x0e,0xc7,0x5a}}, 
  {3,   0, 1, "030",    "192.168.1.30",   "Серв_Почта",  {0xc8,0x60,0x00,0xc7,0xb0,0x8a}},
  {4,   0, 1, "088",    "192.168.1.88",   "Серв_Домен",  {0xc8,0x60,0x00,0xc7,0xb1,0xba}}, 
  {5,   0, 1, "201",    "192.168.1.201",  "Телефон",     {0x00,0x00,0xa9,0xaf,0x3a,0xce}},
  {6,   0, 1, "102",    "192.168.1.102",  "Часы",        {0x00,0x00,0x04,0xef,0xdd,0xd8}}, 
  {7,   0, 1, "040",    "192.168.1.40",   "Esp_Сервер",  {0x00,0x00,0x34,0x96,0x34,0xa8}}, 
  {9,   0, 1, "012",    "192.168.1.12",   "Ноутбук",     {0x00,0x00,0x4e,0xeb,0x47,0x1d}}, 
  {10,   0, 1, "199",    "192.168.1.199",  "Роутер",      {0x00,0x00,0x2b,0x2a,0xad,0x8c}}, 
  {11,  0, 1, "208",    "192.168.1.208",  "Незнаю",      {0x00,0x00,0x4d,0x63,0xa2,0x58}}, 
  {12,  0, 1, "213",    "192.168.1.213",  "Незнаю",      {0x00,0x00,0x00,0xc7,0xb0,0xb7}}, 
  {13,  0, 0, "000",   "192.168.1.00",    "н      ",     {0x00,0x00,0x98,0xf8,0x25,0x97}}, 
  {14,  0, 0, "000",   "192.168.1.000",   "н      ",     {0x00,0x00,0xc5,0xbb,0xda,0xba}},
  {15,  0, 0, "214",    "192.168.1.214",  "Незнаю",      {0x00,0x60,0x00,0xc7,0xb0,0xb7}},   
   
  {16,  0, 0, "000",   "192.168.1.000",   "н      ",     {0x00,0xae,0xc5,0xbb,0xda,0xba}}

};
#endif
///////////////////////////////////////////////////////////////////////////////////////////////////////////////////////////////////////////
///////////////////////////////////////////////////////////////////////////////////////////////////////////////////////////////////////////
///////////////////////////////////////////////////////////////////////////////////////////////////////////////////////////////////////////
IPAddress subnet(255, 255, 255, 0);
IPAddress secondaryDNS(8, 8, 8, 8); // опционально
AsyncPing userPinger;
ESP8266WebServer HTTP(80);
ESP8266HTTPUpdateServer httpUpdater;

//-------------------------------------------------------------------------------------------------------------------------------------------------------------------------
const uint16_t kIrLed = 12; //ПИН ИК передатчика
IRsend irsend(kIrLed);
//21
//uint16_t rawData_on[439] = {3488, 1716,  440, 1282,  444, 416,  444, 420,  440, 420,  440, 1280,  444,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 362,  524};  // DAIKIN216
//23_fan2
uint16_t rawData_on[439] = {3490, 1682,  498, 1226,  470, 420,  440, 392,  470, 416,  444, 1280,  444,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 392,  466};  // DAIKIN216
//22_fan2
////uint16_t rawData_on[439] = {3516, 1682,  444, 1278,  444, 420,  444, 414,  444, 420,  444, 1278,  470,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 446,  412};  // DAIKIN216

//cool off
uint16_t rawData_Off[439] = {3518, 1652,  470, 1254,  498, 362,  502, 362,  498, 362,  498, 1228,  496,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 1312,  386};  // DAIKIN216

//fan on
//uint16_t rawData_on_f[439] = {3486, 1684,  498, 1226,  470, 390,  496, 362,  472, 394,  470, 1248,  472,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 1280,  444};  // DAIKIN216
//21 f2
uint16_t rawData_on_f[439] = {3488, 1716,  440, 1282,  444, 416,  444, 420,  440, 420,  440, 1280,  444,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 362,  524};  // DAIKIN216
//fan of
//uint16_t rawData_Off_f[439] = {3490, 1710,  444, 1276,  470, 394,  444, 416,  470, 388,  444, 1280,  444,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 1334,  386};  // DAIKIN216
// 22 f2
uint16_t rawData_Off_f[439] = {3516, 1682,  444, 1278,  444, 420,  444, 414,  444, 420,  444, 1278,  470,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 446,  412};  // DAIKIN216
//---------------------------------------------------------------------------------------------------------------------------------------------------------------------------------------
uint16_t m , h, s ,dn;
//uint8_t kol_eror_ntp; //количество ошибочных ответов от сервера врмени чтобы не долбило постоянно и не зповисало все 
unsigned int  localPort = 2390;      // local port to listen for UDP packets
unsigned long ntp_time = 0;
unsigned long ntp_time2 = 0;
long  t_correct        = 0;
unsigned long cur_ms   = 0;
unsigned long ms1      = 0;
unsigned long ms2      = 10000000UL;
unsigned long t_cur    = 0;
bool          points   = true;  //для мигании точки я не использую
unsigned int err_count = 0;//количество ошибочных ответов от сервера врмени чтобы не долбило постоянно и не зповисало все 
#define TIMEZONE 2  //3//2
// Для работы NTP
IPAddress timeServerIP; 
const char* ntpServerName = "132.163.96.6";
const int NTP_PACKET_SIZE = 48; 
byte packetBuffer[ NTP_PACKET_SIZE]; 
WiFiUDP udp;
                                              
FtpServer ftpSrv;                                                       
///String handleRelaySwitch();
//const int8_t maxRelays = 5;
//int8_t relayPin[maxRelays] = {2,5,4,16};
//int8_t relayPin[maxRelays] = {(int)relayPin0,(int)relayPin1,(int)relayPin2,(int)relayPin3}; //хранится номер пина
//bool relayLevel[maxRelays];

uint8_t pin_ip_caun;
uint8_t rele[kol_kom];    //масив для релле
uint8_t kond[4];    //масив для релле
uint8_t ping_ok[kol_kom];    //масив для пинга ок

//int inc_web;  //для иницелизации в вебе
//uint32_t coun_W_pk; //счетчик очередности отправк пробуждения на все компыcoun


/////////////////////////////////////////////////////
//-------------------------------------------------------------------------------------------------------------------------
const byte targetIPAddress[] = { 192, 168, 1, 255 };    // IP адрес компа, который нужно разбудить. Также можно указать широковещательный адрес сети, указав в 4м сегменте 255
const int targetWOLPort = 9;                            // WOL порт. Обычно 7 или 9
//const unsigned int localUdpPort = 12345;
//const int kol_kom=21;
//int pin_ip_caun;
//int inc_web;  //для иницелизации в вебе
uint32_t coun_W_pk; //счетчик очередности отправк пробуждения на все компыcoun
static unsigned long t_w_vse = millis();
static unsigned long t_w_vse_S= millis();  //wak для всех компо  поочередная переборка 
static unsigned long t_ping = millis(); 
uint32_t f_paket[kol_kom]; //флаг для отправ пакетов на все компы 
uint32_t f_paket_b; //флаг для отправ пакетов 
uint32_t f_paket_b_S; //флаг для отправ пакетов Серверов
uint32_t f_paket_b_K; //флаг для отправ пакетов Серверов
boolean f_otpr_wr; //флаг отправки пакетов запуска по времени 8.0
boolean f_otpr_wr_S; //флаг отправки пакетов запуска по времени для серверов 7.30
boolean f_otpr_wr_K; //флаг отправки пакетов запуска по времени для серверов 8.30

boolean f_otpr_skl; //флаг отправки пакетов запуска по времени для серверов 8.30
/////////////////////////////////////////////////////////////////////////////////////////////////////////////////////////////////////////////


void sendUserPing(const char* ipaddress, u8_t count, u32_t timeout) ;

//const char fun_test = funk(){int =1;};




void loop() {

 // visov (1,2);  
     static unsigned long t_clkok = millis()  ; //обновляем время 
      String whiteListPhones = "+380660507748, +380672045106"; // Белый список телефонов
      //if (digitalRead(14)==0) {if (f_pina_energy==0) {f_pina_energy=1; sendSMS("+380672045106", "220 ok");   if (_com_sql) {Serial.println("отправляю  SMS");} }  }    //есть електричество
      if (digitalRead(14)==0) {if (f_pina_energy==0) {f_pina_energy=1; sendSMS(nomer_с, "220 ok");   if (_com_sql) {Serial.println("отправляю  SMS");} }  }    //есть електричество
      if (digitalRead(14)==1) {if (f_pina_energy==1) {f_pina_energy=0;  sendATCommand(nomer_с+";", true);  if (_com_sql) {Serial.println("звоню");}  }  }   //нет елетричества
      //if (digitalRead(14)==1) {if (f_pina_energy==1) {f_pina_energy=0;  sendATCommand("ATD+380672045106;", true);  if (_com_sql) {Serial.println("звоню");}  }  }   //нет елетричества

     if ((h==8)&& (m==7)) { 
        if (!f_send_sms_time){
            f_send_sms_time=1;
            sendSMS(nomer_с, "Clock=" +String(h)+":"+String(m)+"\nUlic="+String(TempDs18[1].tDs)+"\nUlic_="+String(TempDs18[0].tDs) +"\nUlic="+String(TempDs18[4].tDs) +"\nServ="+String(TempDs18[2].tDs) +"\nKomn="+String(TempDs18[3].tDs) ); 
        }

      } else { f_send_sms_time=0;}  
      
  if (TempDs18[2].tDs>24&&TempDs18[2].tDs!=85) { 
    if (!f_send_sms_temper)
      { f_send_sms_temper=1; 
      sendSMS(nomer_с, "Warning\nServ="+String(TempDs18[2].tDs));
      }

  } else  if (TempDs18[2].tDs<21) {f_send_sms_temper=0;}


    if (millis()-t_wifi >50000) {    t_wifi = millis(); if(_Dwifi){Serial.println("проверка файфая");} while (WiFi.status() != WL_CONNECTED) { delay(500);Serial.print("."); if(raz_podk++>50){ESP.reset(); }}  }
    delay(1);
    pingg(5000);
    delay(1);
    HTTP.handleClient();                                                // Обработчик HTTP-событий (отлавливает HTTP-запросы к устройству и обрабатывает их в соответствии с выше описанным алгоритмом)
    delay(1);
    ftpSrv.handleFTP();                                                 // Обработчик FTP-соединений  
    delay(1);
    clok();   
    //  if (millis()-t_clkok >5000) {  WiFiupd();  if(god == 1970) { delay(100);WIFITimeUpdate=true;WiFiupd();}  t_clkok=millis();}
    ds1820_z(3000); //опрос датчиков
    delay(1);
 
    WOL();  //обработка wek 
  
    //if (millis()-t_SQL >40000) { t_SQL= millis(); if (millis()>30000){bd_sql();}}  //записываем в базу данных   //bd_sql(); //при старте чтобы не писать не считаные значения температур
  
    if(doma==1){    if (s>35) { if (!f_otpr_skl){f_otpr_skl=1;bd_sql();}}  else { f_otpr_skl=0;}    } //дома работе
    //if(doma==2){    if (s>50) { if (!f_otpr_skl){f_otpr_skl=1;bd_sql();}}  else { f_otpr_skl=0;}    } //дома датчик
    //if(doma==3){    if (s>45) { if (!f_otpr_skl){f_otpr_skl=1;bd_sql();}}  else { f_otpr_skl=0;}    }


     if (SIM800.available())   { 
    _response = waitResponse(); //ечли что пришло то читаем значениея через фукцию ожидания ответа
    _response.trim();  
     if (_com_tel) {Serial.println(_response);}                  
     // проверяем начинается ли строка на RING в стоке _response  
     if (_response.startsWith("RING")) { int phoneindex = _response.indexOf("+CLIP: \"");//ищим  +CLIP: " в _response если находим то возращаем идекс найденого или иначе -1 если найдена то phoneindex>-1
      String innerPhone = "";
      // Если нащли +CLIP: " то   phoneindex будет больше  -1 
      if (phoneindex >= 0) 
      { phoneindex += 8; if(_com_tel){Serial.println(phoneindex);}
      // к полученому индексу добавляем 8 
        int8_t inndd=_response.indexOf("\"", phoneindex);  //находим кавычки с учетом индекса
        innerPhone = _response.substring(phoneindex,inndd ); //находим телефон
        if(_com_tel){Serial.println("Number: " + innerPhone);} // Выводим номер в монитор порта
      }
      if(_com_tel){Serial.println("111111: " + whiteListPhones);}
      // Проверяем, чтобы длина номера была больше 6 цифр, и номер должен быть в списке
      if (innerPhone.length() >= 7 && whiteListPhones.indexOf(innerPhone) >= 0) {
        sendATCommand("ATA", true);        // Если да, то отвечаем на вызов
      }
      else {
        sendATCommand("ATH", true);        // Если нет, то отклоняем вызов
      }
    }
  }
  
}
